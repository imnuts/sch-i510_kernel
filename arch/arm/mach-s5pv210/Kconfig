## arch/arm/mach-s5pv210/Kconfig
```kconfig
# arch/arm/mach-s5pv210/Kconfig
#
# Copyright (c) 2010 Samsung Electronics Co., Ltd.
#		http://www.samsung.com/
#
# Licensed under GPLv2

# Configuration options for the S5PV210/S5PC110

if ARCH_S5PV210

config CPU_S5PV210
	bool
	select PLAT_S5P
	select S5PV210_PM if PM
	help
	  Enable S5PV210 CPU support

choice
	prompt "Select machine type"
	depends on ARCH_S5PV210
	default MACH_SMDKV210

config MACH_SMDKV210
	bool "SMDKV210"
	select CPU_S5PV210
	select ARCH_SPARSEMEM_ENABLE
	select S3C_DEV_HSMMC
	select S3C_DEV_HSMMC1 if !S5PV210_SD_CH0_8BIT
	select S3C_DEV_HSMMC2
	select S3C_DEV_HSMMC3 if !S5PV210_SD_CH2_8BIT
	select S5PV210_SETUP_SDHCI
	select PCI
	help
	  Machine support for Samsung SMDKV210

config MACH_SMDKC110
	bool "SMDKC110"
	select CPU_S5PV210
	select DISCONTIGMEM
	select S3C_DEV_HSMMC
	select S3C_DEV_HSMMC1 if !S5PV210_SD_CH0_8BIT
	select S3C_DEV_HSMMC2
	select S3C_DEV_HSMMC3 if !S5PV210_SD_CH2_8BIT
	select S5PV210_SETUP_SDHCI
	select ARCH_DISCONTIGMEM_ENABLE
	select PCI
	help
	  Machine support for Samsung SMDKC110
	  S5PC110(MCP) is one of package option of S5PV210

config MACH_S5PC110_ARIES
        bool "S5PC110_ARIES"
        select CPU_S5PV210
        select DISCONTIGMEM
        select S3C_DEV_HSMMC
        select S3C_DEV_HSMMC1 if !S5PV210_SD_CH0_8BIT
        select S3C_DEV_HSMMC2
        select S5PV210_SETUP_SDHCI
        select ARCH_DISCONTIGMEM_ENABLE
        select PCI
        help
          Machine support for Samsung S5PC110_ARIES 

config MACH_S5PC110_P1
        bool "S5PC110_P1"
        select CPU_S5PV210
        select DISCONTIGMEM
        select S3C_DEV_HSMMC
        select S3C_DEV_HSMMC1 if !S5PV210_SD_CH0_8BIT
        select S3C_DEV_HSMMC2
        select S5PV210_SETUP_SDHCI
        select ARCH_DISCONTIGMEM_ENABLE
        select PCI
        help
          Machine support for Samsung S5PC110_P1 

endchoice

choice
	prompt "CPU revision"
	depends on CPU_S5PV210
	default CPU_S5PV210_EVT1

config CPU_S5PV210_EVT0
	bool "EVT0"
	help
	  Support EVT0

config CPU_S5PV210_EVT1
	bool "EVT1"
	help
	  Support EVT1
endchoice

choice
        prompt "Select Board Type"

config ARIES_EUR
        bool "select S1 Europe"
        depends on MACH_S5PC110_ARIES
        help
	  Select S1 Europe

config ARIES_NTT
        bool "select S1 NTT"
        depends on MACH_S5PC110_ARIES
        help
          Select S1 NTT

config STEALTHV
        bool "select Stealth V"
        depends on MACH_S5PC110_ARIES
        help
	  Select Stealth VIA

config PRESTO
        bool "select Presto"
        depends on MACH_S5PC110_ARIES
        help
          Select Presto
endchoice


config DM9000_16BIT
	bool "DM9000 16-bit"
	depends on MACH_SMDKV210 || MACH_VOGUEV210
	default n
	help
	  Support DM9000 ethernet controller with 16bit data bus

config S5PV210_PM
	bool
	help
	  Power Management code common to S5PV210

config S5PV210_SETUP_SDHCI
	bool
	depends on PLAT_S5P
	default y
	help
	  Internal helper functions for S5PCV210 based SDHCI systems

comment "MMC/SD slot setup"
depends on PLAT_S5P

menu "Use 8-bit bus width"
config S5PV210_SD_CH0_8BIT
bool "Channel 0"
depends on PLAT_S5P
default n
help
IF channel 0 uses 8-bit bus, channel 1 is disabled.

config S5PV210_SD_CH2_8BIT
bool "Channel 2"
depends on PLAT_S5P
default n
help
IF channel 2 uses 8-bit bus, channel 3 is disabled.
endmenu

# platform specific device setup
config S5PV210_SETUP_FB
        bool
        depends on FB_S3C
        default y
        help
          Common setup code for FIMD controller.

config S5PV210_ADCTS
	bool "S5PV210 ADCTS Driver"
	default n
	help
	  Common setup code for adc and touchscreen

config S5P_ADC
	bool	"S5PXXXX ADC driver"
	depends on PLAT_S5P
	default y
	help
	  ADC ( A/D Conversion ) driver for Samsung S5PXXXX

config S5PV210_SETUP_FIMC0
	bool
	depends on VIDEO_FIMC
	default y
	help
	  Common setup code for FIMC controller 0.

config S5PV210_SETUP_FIMC1
	bool
	depends on VIDEO_FIMC
	default y
	help
	  Common setup code for FIMC controller 1.

config S5PV210_SETUP_FIMC2
	bool
	depends on VIDEO_FIMC
	default y
	help
	  Common setup code for FIMC controller 2.

config S5PV210_SETUP_CSIS
	bool
	depends on VIDEO_FIMC
	default y
	help
	  Common setup code for MIPI-CSIS

config PRESTO_DEBUG_LED
	bool
	depends on PRESTO
	default y
	help
	  Common setup code for MIPI-CSIS
endif
```

## arch/arm/plat-s5p/Kconfig
```kconfig
# arch/arm/plat-s5p/Kconfig
#
# Copyright (c) 2009 Samsung Electronics Co., Ltd.
#		http://www.samsung.com/
#
# Licensed under GPLv2

config PLAT_S5P
	bool
	depends on (ARCH_S5P6440 || ARCH_S5P6442 || ARCH_S5PV210)
	default y
	select ARM_VIC
	select NO_IOPORT
	select ARCH_REQUIRE_GPIOLIB
	select S3C_GPIO_TRACK
	select SAMSUNG_GPIOLIB_4BIT
	select S3C_GPIO_CFG_S3C64XX
	select S3C_GPIO_PULL_UPDOWN
	select S3C_GPIO_CFG_S3C24XX
	select PLAT_SAMSUNG
	select SAMSUNG_CLKSRC
	select SAMSUNG_IRQ_VIC_TIMER
	select SAMSUNG_IRQ_UART
	help
	  Base platform code for Samsung's S5P series SoC.

config SYSTIMER_S5P
	bool
	depends on (ARCH_S5P6442 || ARCH_S5PV210)
	default y
	help
	  Support System Timer for S5P Series

config S5P_DMA_PL330
	bool
	depends on ARCH_S5PV210
	default y
	help
	  Support DMA PL330 for all SAMSUNG S5P SOCs.

config S5P_SETUP_I2C0
	bool
	default y
	help
	  Common setup code for i2c bus 0.

config S5P_SETUP_I2C1
	bool
	default y
	help
	  Common setup code for i2c bus 1.

config S5P_SETUP_I2C2
	bool
	default y
	help
	  Common setup code for i2c bus 2.

# FB part
config S5P_DEV_FB
        bool
        depends on FB_S3C
        default y
        help
          Compile in platform device definitions for FIMD controller

# FIMC part
config S5P_DEV_FIMC0
	bool
	depends on VIDEO_FIMC
	default y
	help
	  Compile in platform device definitions for FIMC controller 0

config S5P_DEV_FIMC1
	bool
	depends on VIDEO_FIMC
	default y
	help
	  Compile in platform device definitions for FIMC controller 1

config S5P_DEV_FIMC2
	bool
	depends on VIDEO_FIMC
	default y
	help
	  Compile in platform device definitions for FIMC controller 2

# IPC part
config S5P_DEV_IPC
	bool
	depends on VIDEO_FIMC
	default y
	help
	  Compile in platform device definitions for IPC

# MIPI-CSIS part
config S5P_DEV_CSIS
	bool
	depends on VIDEO_FIMC
	default y
	help
	  Compile in platform device definitions for MIPI-CSIS

# MFC part
config S5P_DEV_MFC
	bool
	default y
	help
	  Compile in platform device definitions for MFC

config S5P_SETUP_MFC
	bool
	default y
	help
	  Common setup code for MFC

config S5P_LPAUDIO
	bool "Support S5P Low Power(LP) Audio"
	depends on (CPU_IDLE && PM)
#	default y
	help
	  s5pc11x low power audio enable / disable

config S5P_HIGH_RES_TIMERS
	bool "HRtimer and Dynamic Tick support"
	select GENERIC_TIME
	select GENERIC_CLOCKEVENTS
	select HIGH_RES_TIMERS
	select HRT_RTC
	default n
	help
	  Support for HRtimer and Dynamic Tick system.

config HRT_RTC
	bool
	depends on S5P_HIGH_RES_TIMERS
	default y
	help
	  RTC and System timer are used as HRT
```

## drivers/cdma_dpram/Kconfig
```kconfig
#
# CMDA DPRAM DRIVER configuration
#
config SAMSUNG_PHONE_TTY
	tristate "Samsung CDMA Phone Interface - TTY"
	depends on !SAMSUNG_DPRAM
	default n
	---help---
	  This is worked for steath-v VIA CDMA modem.
	  The ppp daemon is using the tty interface.
	  When in doubt, say N.
```

## drivers/cdma_idpram/Kconfig
```kconfig
#
# OneDRAM configuration
#
menuconfig QSC_IF_C110_IDPRAM
	tristate "S5PC110 Internal DPRAM for interface to QSC60x5 CDMA modem"
	default n
	---help---
	  By default, n
	  When in doubt, say N.
```

## drivers/internal_dpram/Kconfig
```kconfig
#
# CMDA DPRAM DRIVER configuration
#
config SAMSUNG_PHONE_DPRAM_INTERNAL
	tristate "Samsung CDMA Phone Interface - S.LSI internal DPRAM"
	depends on !SAMSUNG_DPRAM
	default n
	---help---
	  This is worked for steath-v VIA CDMA modem.
	  The ppp daemon is using the tty interface.
	  When in doubt, say N.
```

## drivers/ltespi/Kconfig
```kconfig
#
#
#
config LTESPI
	tristate "LTE SPI"
#	depends on SAMSUNG_MODULES && SAMSUNG_PHONE_SVNET
	default m
	help
	Say Y to enable SPI driver for LTE  support.
```

## drivers/media/video/samsung/rotator/Kconfig
```kconfig
#
# Configuration for rotator
#

config VIDEO_ROTATOR
	bool "Samsung Image Rotator Driver" 
	depends on VIDEO_SAMSUNG && (CPU_S5PV210_EVT1)
	default n
	---help---
	  This is a Rotator for Samsung CPU_S5PV210_EVT1.
```

## drivers/misc/samsung_modemctl/Kconfig
```kconfig
#
#
#
config SAMSUNG_MODEMCTL
	tristate "Samsung Modem Control/IO Driver"
	default m

config PHONE_ONEDRAM
	tristate "OneDRAM"
	default m

config SAMSUNG_PHONE_SVNET
	tristate "Samsung Virtual Network"
	default m

config SVNET_WHITELIST
	bool "svnet uses whitelist via onedram"
	depends on SAMSUNG_PHONE_SVNET
	default n
	---help---
	  By default, n
	  When in doubt, say N.
```

## drivers/samsung/Kconfig
```kconfig
#
#
#

menuconfig SAMSUNG_MODULES
	tristate "Samsung Kernel Modules"
	default m
	help
	  Say Y to enable Samsung kernel modules. j4fs and param
	  modules are included.

menuconfig FM_SI4709
	tristate "Si4709 FM radio"
	depends on SAMSUNG_MODULES
	default m
	help
	  Say Y to enable Si4709 FM radio support.

menuconfig VIBETONZ
	tristate "Vibetonz"
	depends on SAMSUNG_MODULES
	default m
	help
	  Say Y to enable Vibetonz support.

menuconfig LEVEL
	tristate "Level"
	depends on SAMSUNG_MODULES && SAMSUNG_PHONE_SVNET
	default m
	help
	  Say Y to enable Debug Level support.

menuconfig LTESPI
	tristate "LTE SPI"
	depends on SAMSUNG_MODULES && SAMSUNG_PHONE_SVNET
	default m
	help
	  Say Y to enable SPI driver for LTE  support.
```

## drivers/sensor/Kconfig
```kconfig
menuconfig SENSOR
	bool "Sensors Support"
	help
	  Say Y to enable Sensors support.  This allows control of supported
	  Sensors.

if SENSOR

source "drivers/sensor/compass/Kconfig"

source "drivers/sensor/optical/Kconfig"

source "drivers/sensor/gyro/Kconfig"

endif # SENSOR
```

## drivers/sensor/accel/Kconfig
```kconfig
#
# Accelerometer Sensor Configuration
#



config ACCEL                                                              
	bool "Accelerometer Sensor"
	default y
	help
	This option enables accelerometer sensors  
	   
config ACCEL_KR3DM
        depends on ACCEL
        tristate "KR3DM driver for s3c6410"
        default y
        help
          This option enables accelerometer sensors using kr3dm driver.
          It is optimized for s3c6410.
```

## drivers/sensor/compass/Kconfig
```kconfig
#
# MAGNETIC Sensor Configuration
#

config COMPASS
	bool "Sensors"
	default n
	help
	  This option enables sensors


config COMPASS_YAMAHA
	depends on COMPASS
	tristate "YAMAHA"
	default y
	help
	  This option enables magnetic sensors using YAMAHA driver.
	  It is optimized for s3c6410.
```

## drivers/sensor/gyro/Kconfig
```kconfig
#
# Gyro Sensor Configuration
#

config GYRO                                                            
	bool "Gyro Sensor"
	default y
	help
	This option enables Gyro sensors  

config SENSORS_L3G4200D_GYRO
	tristate "ST L3G4200D Gyro sensor support"
	depends on I2C=y
	default y
	help
	  If you say yes here you get support for STMicro's 
```

## drivers/swi/Kconfig
```kconfig
config SWI
	tristate "GPIO-based bitbanging SWI support"
	depends on GENERIC_GPIO
	default y
	help
		This is GPIO bitbanging Single-wired interface driver
		and could be used for Backlight device with single-wired
		interface.

		backlight driver could control single-wired interface based
		on GPIO as registering interface specific data to swi_board_info
		and backlight driver to swi driver.
		swi_board_info.controller_data holds the GPIO number for
		interfacing between CPU and Device.
```

## drivers/wtlfota_dpram/Kconfig
```kconfig
# drivers/wtlfota_dpram/Kconfig
#
#

config SAMSUNG_WTL_FOTA_DPRAM
	tristate "Samsung WTL DPRAM driver for CP FOTA update"
	depends on SAMSUNG_MODULES
	default n
	help
	  This module is needed in recovery image to update CP.
```

## fs/rfs/Kconfig
```kconfig
menu "RFS Filesystem"

config RFS_FS
       tristate "Robust FAT Filesystem (RFS) support"
       default m
       help    
         Samsung Robust File System support.

config RFS_VFAT
       bool "FAT && long file name support"
       default y
       depends on RFS_FS

config RFS_SYNC_ON_CLOSE
       bool "Sync on close support"
       depends on RFS_FS

config RFS_NLS
       bool "Support NLS on RFS filesystem"
       select NLS
       default y
       depends on RFS_VFAT

config RFS_DEFAULT_CODEPAGE
       string "Use default NLS codepage"
       default NLS_DEFAULT 
       depends on RFS_NLS

config RFS_POSIX_ATTR
        bool "POSIX attribute support"
       default false
        depends on RFS_FS

config RFS_FS_XATTR
        bool "RFS extended attributes"
        depends on RFS_FS
        default false 
        help
        Extended attributes are name:value pairs associated with inodes
        by the kernel or by users (see the attr(5) manual page,
        or visit <http://acl.bestbits.at/> for details).

config RFS_FS_SECURITY
        bool "RFS Security Labels"
        depends on RFS_FS_XATTR
        help
        Security labels support alternative access control models
        implemented by security modules like SELinux.
        This option enables an extended attribute namespace
        for inode security labels in the RFS filesystem.

#config RFS_FS_FULL_PERMISSION
#       bool "support 32bit uid, gid"
#       depends on RFS_FS_XATTR && RFS_POSIX_ATTR

config RFS_FAST_LOOKUP
        bool "RFS fast file lookup"
       default false
        depends on RFS_FS

config RFS_FAST_SEEK
        bool "RFS fast seek"
       default false
        depends on RFS_FS

#config RFS_QUOTA
#       bool
#       depends on QUOTA && RFS_POSIX_ATTR
#       default y

config RFS_UID_BITS
        int
        default 8
        depends on RFS_POSIX_ATTR

config RFS_FAT_DEBUG
       bool "FAT Debug Message support"
       depends on RFS_FS

config RFS_FAT_DEBUG_VERBOSE
       int "Debugging versosity (0 = quiet, 3 = noisy)"
       default 0
       depends on RFS_FAT_DEBUG

config RFS_MAPDESTROY
       bool
       default false 

config RFS_PRE_ALLOC
       int
       default 50

config RFS_VERSION
       string
       default "RFS_1.3.1_b070"

endmenu
```

## fs/rfs/Kconfig.rej
```kconfig
--- fs/rfs/Kconfig (.../RFS_1.2.2p1-rc2_kernel_m64_SamyGO_port)    (Revision 1229)
+++ fs/rfs/Kconfig (.../RFS_1.3.1_b070_kernel_m64_SamyGO_port)     (Arbeitskopie)
@@ -2,11 +2,13 @@
 
 config RFS_FS
        tristate "Robust FAT Filesystem (RFS) support"
+       default m
        help
          Samsung Robust File System support.
 
 config RFS_VFAT
        bool "FAT && long file name support"
+       default y
        depends on RFS_FS
 
 config RFS_SYNC_ON_CLOSE
```
